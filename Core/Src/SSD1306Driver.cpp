#include "SSD1306Driver.h"
#include <cstring>
#include <cstdio>

namespace WeatherStation {
	const uint8_t SSD1306Driver::kFont5x7[][5] = {
		{0x00,0x00,0x00,0x00,0x00}, // ' '
		{0x00,0x00,0x5F,0x00,0x00}, // '!'
		{0x00,0x07,0x00,0x07,0x00}, // '"'
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		{0x08,0x08,0x2A,0x1C,0x08}, // '~'
	};

	static const uint8_t kInitCmds[] = {
		0xAE, // Display OFF
		0xD5,0x80, // Set display clock divide ratio
		0xA8,0x3F, // Set multiplex ratio
		0xD3,0x00, // Set display offset
		0x40, // Set start line
		0x8D,0x14, // Enable charge pump
		0x20,0x00, // Memory addressing mode horizontal
		0xA1, // Segment re-map
		0xC8, // COM output scan direction
		0xDA,0x12, // COM pins hardware config
		0x81,0xCF, // Contrast
		0xD9,0xF1, // Pre-charge period
		0xDB,0x40, // VCOMH deselect level
		0xA4, // Entire display ON
		0xA6, // Normal display
		0xAF, // Display ON
	};

	SSD1306Driver::SSD1306Driver(I2C_HandleTypeDef& hi2c, uint8_t devAddr, uint8_t contrast) : m_hi2c(hi2c), m_addr(devAddr), m_contrast(contrast)
	{
		std::memset(m_fb, 0, kBufSize);
	}

	bool SSD1306Driver::init()
	{
		if (HAL_I2C_IsDeviceReady(&m_hi2c, m_addr, 3, 10) != HAL_OK)
			return false;

		sendCmdList(kInitCmds, sizeof(kInitCmds));

		sendCmd(0x81);
		sendCmd(m_contrast);

		clear();
		flush();
		return true;
	}

	void SSD1306Driver::clear()
	{
		std::memset(m_fb, 0, kBufSize);
	}

	void SSD1306Driver::flush()
	{
		sendCmd(0x21); sendCmd(0); sendCmd(kWidth - 1);
		sendCmd(0x22); sendCmd(0); sendCmd(kPages - 1);

		uint8_t header = 0x40;
		HAL_I2C_Mem_Write(&m_hi2c, m_addr, 0x40, I2C_MEMADD_SIZE_8BIT, m_fb, kBufSize, kTimeout);
		(void)header;
	}

	void SSD1306Driver::drawPixel(uint8_t x, uint8_t y, bool on)
	{
		if (x >= kWidth || y >= kHeight) return;
		uint16_t idx = static_cast<uint16_t>(x) + (y / 8) * kWidth;
		if (on) m_fb[idx] |=  (1u << (y & 7));
		else m_fb[idx] &= ~(1u << (y & 7));
	}

	void SSD1306Driver::drawChar(uint8_t x, uint8_t y, char c, uint8_t scale)
	{
		if (c < 32 || c > 126) c = '?';
		const uint8_t* glyph = kFont5x7[static_cast<uint8_t>(c) - 32];
		for (uint8_t col = 0; col < 5; ++col) {
			uint8_t colData = glyph[col];
			for (uint8_t row = 0; row < 7; ++row) {
				bool on = (colData >> row) & 1;
				for (uint8_t sy = 0; sy < scale; ++sy)
					for (uint8_t sx = 0; sx < scale; ++sx)
						drawPixel(x + col * scale + sx, y + row * scale + sy, on);
			}
		}
	}

	void SSD1306Driver::drawString(uint8_t x, uint8_t y, const char* str, uint8_t scale)
	{
		uint8_t cx = x;
		while (*str) {
			if (cx + 5 * scale > kWidth) break;
			drawChar(cx, y, *str++, scale);
			cx += (5 + 1) * scale;
		}
	}

	void SSD1306Driver::drawHLine(uint8_t x, uint8_t y, uint8_t len)
	{
		for (uint8_t i = 0; i < len; ++i)
			drawPixel(x + i, y, true);
	}

	void SSD1306Driver::drawRect(uint8_t x, uint8_t y, uint8_t w, uint8_t h, bool filled)
	{
		if (filled) {
			for (uint8_t row = 0; row < h; ++row)
				for (uint8_t col = 0; col < w; ++col)
					drawPixel(x + col, y + row, true);
		} else {
			drawHLine(x, y, w);
			drawHLine(x, y + h - 1, w);
			for (uint8_t row = 1; row < h - 1; ++row) {
				drawPixel(x, y + row, true);
				drawPixel(x + w - 1, y + row, true);
			}
		}
	}

	void SSD1306Driver::sendCmd(uint8_t cmd)
	{
		uint8_t buf[2] = { 0x00, cmd };
		HAL_I2C_Master_Transmit(&m_hi2c, m_addr, buf, 2, kTimeout);
	}

	void SSD1306Driver::sendCmdList(const uint8_t* cmds, uint8_t len)
	{
		for (uint8_t i = 0; i < len; ++i)
			sendCmd(cmds[i]);
	}
}
